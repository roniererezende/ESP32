## Blink_Franzininho_WiFi/sdkconfig.defaults
```kconfig
CONFIG_ESP_CONSOLE_USB_CDC=y
CONFIG_ESPTOOLPY_FLASHSIZE_4MB=y
CONFIG_IDF_TARGET="esp32s2"
CONFIG_BLINK_LED_GPIO=y
CONFIG_BLINK_GPIO=21
#define CONFIG_WiFi_SSID "Malware"
```
